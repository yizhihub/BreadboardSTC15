#include "boled.h"

u16 BACK_COLOR = BLACK;
u16 FRONT_COLOR = YELLOW;

#ifdef FEATURE_F8x16
//======================================================
// 128X64I液晶底层驱动[8X16]字体库
// 设计者: powerint
// 描  述: [8X16]西文字符的字模数据 (纵向取模,字节倒序)
// !"#$%&'()*+,-./0123456789:;<=>?@ABCDEFGHIJKLMNOPQRSTUVWXYZ[\]^_`abcdefghijklmnopqrstuvwxyz{|}~
//======================================================
CONST_DATA unsigned char F8X16[][16]={
  0x00,0x00,0x00,0x00,0x00,0x00,0x00,0x00,0x00,0x00,0x00,0x00,0x00,0x00,0x00,0x00,// 0
  0x00,0x00,0x00,0xF8,0x00,0x00,0x00,0x00,0x00,0x00,0x00,0x33,0x30,0x00,0x00,0x00,//!1
  0x00,0x10,0x0C,0x06,0x10,0x0C,0x06,0x00,0x00,0x00,0x00,0x00,0x00,0x00,0x00,0x00,//"2
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  0xFF,0xFF,0xFF,0xFF,0xFF,0xFF,0xFF,0xFF,0xFF,0xFF,0xFF,0xFF,0xFF,0xFF,0xFF,0xFF,
};
#endif
#ifdef FEATURE_F6x8
CONST_DATA unsigned char F6x8[][6] =
{
    { 0x00, 0x00, 0x00, 0x00, 0x00, 0x00 },   // sp
    { 0x00, 0x00, 0x00, 0x2f, 0x00, 0x00 },   // !
    { 0x00, 0x00, 0x07, 0x00, 0x07, 0x00 },   // "
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    { 0x41, 0x41, 0x22, 0x00, 0x00, 0x00 },   // ℃96
};
#endif
#ifdef FEATURE_F16x32
CONST_DATA unsigned char F16X32[][64]= 
{ 
    0x00,0x00,0x00,0x00,0x00,0x80,0xC0,0x40,0x40,0x40,0xC0,0x80,0x00,0x00,0x00,0x00,
    0x00,0x00,0xF0,0xFE,0x0F,0x01,0x00,0x00,0x00,0x00,0x00,0x01,0x07,0xFE,0xF0,0x00,
    0x00,0x00,0x1F,0xFF,0xE0,0x00,0x00,0x00,0x00,0x00,0x00,0x00,0xC0,0xFF,0x1F,0x00,
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    0x00,0x00,0x00,0x00,0x00,0x00,0x00,0x00,0x00,0x00,0x00,0x00,0x00,0x00,0x00,0x00,/*":", 17*/
//    0x00,0x00,0xE0,0x20,0xC0,0x00,0x80,0xC0,0x60,0x20,0x20,0x40,0x80,0x80,0x00,0x00,
//    0x00,0x00,0x03,0x02,0x01,0xFC,0x03,0x00,0x00,0x00,0x00,0x00,0x01,0x3F,0x00,0x00,
//    0x00,0x00,0x00,0x00,0x00,0x7F,0xC0,0x00,0x00,0x00,0x00,0x00,0x80,0x40,0x00,0x00,
//    0x00,0x00,0x00,0x00,0x00,0x00,0x03,0x06,0x0C,0x0C,0x0C,0x06,0x03,0x00,0x00,0x00, // 摄氏度（小）-18
};   // 阴码，列行式 逆向
#endif

#ifdef FEATURE_HANZI
/*
 * 注意Keil 8051在编译含有0xFD编码的汉字时，会跳过0xFD，比如“数”的GBK编码是0xCA、0xFD，Keil会略掉
 * 0xFD导致出现不可知的现象，Keil官方给出的解决方法是在带有0xFD编码的汉字后增加一个0xFD即可,GBK中
 * 包含0xfd编码的汉字如下：
 * 褒饼昌除待谍洱俘庚过糊积箭烬君魁
 * 例笼慢谬凝琵讫驱三升数她听妄锡淆
 * 旋妖引育札正铸  佚冽邶埤荦蔟摭啐
 * 帻猃恺泯潺妪纨琮椠辇挲臊忑睚铨稞
 * 瘕颀螨簖酏觚鳊鼾
 */
CONST_DATA uint8_t  F14x16_Idx[] =
 "口电压测试当前设定转速";  //温度汉字驱动按键次指南针高距离已发送接收丢包率个数信号强
                                                                 
CONST_DATA uint8_t  F14x16[] = {
0x00,0x00,0xFC,0x04,0x04,0x04,0x04,0x04,0x04,0x04,0x04,0xFC,0x00,0x00,
0x00,0x00,0x3F,0x20,0x20,0x20,0x20,0x20,0x20,0x20,0x20,0x3F,0x00,0x00,// Nozimo
//0x21,0x86,0x70,0x00,0x7E,0x4A,0x4A,0x4A,0x4A,0x4A,0x7E,0x00,0x00,0x00,
//0xFE,0x01,0x40,0x7F,0x41,0x41,0x7F,0x41,0x41,0x7F,0x41,0x41,0x7F,0x40,//温18
//0x00,0xFC,0x04,0x24,0x24,0xFC,0xA5,0xA6,0xA4,0xFC,0x24,0x24,0x24,0x04,
//0x60,0x1F,0x80,0x80,0x42,0x46,0x2A,0x12,0x12,0x2A,0x26,0x42,0xC0,0x40,//度19
//0x10,0x10,0xFF,0x90,0x50,0x98,0x88,0x88,0xE9,0x8E,0x88,0x88,0x98,0x88,
//0x42,0x81,0x7F,0x00,0x40,0x40,0x26,0x25,0x18,0x08,0x16,0x31,0x60,0x20,//按20
//0x30,0xEF,0x28,0x28,0x44,0x64,0xDC,0x10,0x54,0xFF,0x54,0x54,0x7C,0x10,
//0x01,0x7F,0x21,0x51,0x22,0x14,0x0F,0x14,0x25,0x3F,0x45,0x45,0x45,0x44,//键21
//0x02,0x1C,0xC0,0x30,0x4C,0x30,0x0F,0x08,0xF8,0x08,0x08,0x28,0x18,0x08,
//0x5E,0x43,0x20,0x20,0x10,0x08,0x04,0x03,0x01,0x06,0x08,0x30,0x60,0x20,//次22
0x00,0xF8,0x48,0x48,0x48,0x48,0xFF,0x48,0x48,0x48,0x48,0xF8,0x00,0x00,
0x00,0x0F,0x04,0x04,0x04,0x04,0x3F,0x44,0x44,0x44,0x44,0x4F,0x40,0x70,//电23
0x00,0xFE,0x02,0x42,0x42,0x42,0x42,0xFA,0x42,0x42,0x42,0x62,0x42,0x02,
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0x20,0x10,0x0F,0x10,0x28,0x24,0x22,0x21,0x3F,0x21,0x22,0x24,0x28,0x00,//速5
//0x40,0x84,0x08,0x10,0x00,0x04,0xFC,0x04,0x04,0x04,0x84,0x7C,0x00,0x00,
//0x00,0x30,0x0C,0x03,0x40,0x20,0x10,0x0B,0x04,0x0A,0x11,0x20,0x40,0x00,//汉0
//0x38,0x08,0x48,0x48,0x48,0x4A,0x4C,0x48,0xC8,0x48,0x08,0x08,0x38,0x00,
//0x04,0x04,0x04,0x04,0x44,0x44,0x7E,0x05,0x04,0x04,0x04,0x04,0x04,0x00,//字1
//0x04,0xF4,0x04,0x04,0xFC,0x00,0x00,0xFC,0x24,0xC4,0x04,0xE4,0x04,0x00,
//0x10,0x11,0x09,0x49,0x41,0x3F,0x00,0x7F,0x50,0x4C,0x43,0x5C,0x40,0x00,//驱0
//0x40,0x44,0xC4,0x44,0x44,0x40,0x10,0x10,0xFE,0x10,0x10,0x10,0xF0,0x00,
//0x08,0x0E,0x09,0x08,0x0A,0x5C,0x20,0x18,0x07,0x00,0x40,0x40,0x3F,0x00,//动1
//0x10,0x10,0xFE,0x10,0x90,0x00,0x3E,0x48,0x48,0x48,0x44,0x44,0x70,0x00,
//0x42,0x42,0x7F,0x01,0x00,0x00,0x7F,0x49,0x49,0x49,0x49,0x7F,0x00,0x00,//指0
//0x08,0xE8,0x28,0x28,0x68,0xA8,0x3E,0xA8,0x68,0x28,0x28,0xE8,0x08,0x00,
//0x00,0x7F,0x04,0x05,0x05,0x05,0x3F,0x05,0x05,0x45,0x44,0x7F,0x00,0x00,//南1
//0x40,0x20,0x58,0xCE,0x48,0x48,0x00,0x40,0x40,0xFE,0x40,0x40,0x40,0x00,
//0x00,0x02,0x02,0x7F,0x22,0x12,0x00,0x00,0x00,0x7F,0x00,0x00,0x00,0x00,//针2
//0x00,0x04,0x04,0x04,0x74,0x54,0x55,0x56,0x54,0x54,0x74,0x04,0x04,0x04,
//0x00,0x00,0x3F,0x01,0x01,0x1D,0x15,0x15,0x15,0x1D,0x01,0x21,0x3F,0x00,/* 高 */
//0x00,0x00,0xBE,0x22,0xE2,0x22,0x3E,0x00,0xFE,0x22,0x22,0x22,0xE2,0x02,
//0x00,0x10,0x1F,0x10,0x0F,0x09,0x09,0x00,0x3F,0x22,0x22,0x22,0x23,0x20,/* 距 */
//0x00,0x04,0x04,0xF4,0x84,0xD4,0xA5,0xA6,0xA4,0xD4,0x84,0xF4,0x04,0x04,
//0x00,0x00,0x3E,0x02,0x0A,0x0E,0x0A,0x0B,0x0A,0x0E,0x2A,0x22,0x3E,0x00,/* 离 */
//0x00,0x00,0xF2,0x42,0x42,0x42,0x42,0x42,0x42,0x42,0x42,0x42,0x7E,0x00,
//0x00,0x00,0x1F,0x20,0x20,0x20,0x20,0x20,0x20,0x20,0x20,0x20,0x20,0x38,/* 已 */
//0x00,0x00,0x18,0x16,0x10,0xD0,0xB8,0x97,0x90,0x90,0x90,0x92,0x14,0x10,
//0x00,0x08,0x04,0x22,0x21,0x20,0x13,0x14,0x08,0x14,0x12,0x21,0x20,0x20,/* 发 */
//0x00,0x40,0x42,0xCC,0x00,0x40,0x49,0x4A,0x48,0xF8,0x48,0x4A,0x49,0x40,
//0x00,0x20,0x10,0x0F,0x10,0x20,0x28,0x24,0x23,0x20,0x21,0x22,0x2C,0x20,/* 送 */
//0x00,0x08,0x08,0xFF,0x88,0x28,0x24,0x2C,0xF5,0x26,0x34,0x2C,0x24,0x20,
//0x00,0x21,0x21,0x3F,0x00,0x21,0x25,0x17,0x09,0x09,0x15,0x13,0x21,0x01,/* 接 */
//0x00,0x00,0xFC,0x00,0x80,0xFF,0x00,0x20,0x10,0xEF,0x08,0x08,0xF8,0x08,
//0x00,0x00,0x03,0x01,0x00,0x3F,0x00,0x20,0x10,0x0B,0x04,0x0B,0x10,0x20,/* 收 */
//0x00,0x00,0x12,0x12,0x12,0x12,0x12,0xFE,0x12,0x11,0x11,0x11,0x11,0x00,
//0x00,0x01,0x11,0x19,0x15,0x13,0x11,0x11,0x11,0x11,0x15,0x19,0x31,0x01,/* 丢 */
//0x00,0x20,0x10,0xE8,0x27,0x24,0x24,0x24,0x24,0xE4,0x04,0x04,0xFC,0x00,
//0x00,0x00,0x00,0x1F,0x22,0x22,0x22,0x22,0x22,0x23,0x24,0x24,0x23,0x38,/* 包 */
//0x00,0x10,0xA4,0x44,0x04,0x24,0xB5,0x6E,0x24,0x94,0x04,0x44,0xA4,0x10,
//0x00,0x05,0x04,0x04,0x04,0x05,0x05,0x3F,0x05,0x05,0x07,0x04,0x04,0x05,/* 率 */
//0x00,0x40,0x40,0x20,0x10,0x08,0x04,0xE3,0x04,0x08,0x10,0x20,0x40,0x40,
//0x00,0x00,0x00,0x00,0x00,0x00,0x00,0x3F,0x00,0x00,0x00,0x00,0x00,0x00,/* 个 */
//0x00,0x4A,0x2C,0x98,0x7F,0x18,0x2C,0x4A,0x40,0x30,0xCF,0x08,0xF8,0x08,
//0x00,0x21,0x25,0x17,0x19,0x09,0x17,0x20,0x00,0x20,0x13,0x0C,0x13,0x20,/* 数 */
//0x00,0x20,0x10,0xFC,0x03,0x04,0x54,0x54,0x55,0x56,0x54,0x54,0x54,0x04,
//0x00,0x00,0x00,0x3F,0x00,0x00,0x3F,0x11,0x11,0x11,0x11,0x11,0x3F,0x00,/* 信 */
//0x00,0x40,0x40,0x4F,0x49,0xC9,0x49,0x49,0x49,0x49,0x49,0x4F,0x40,0x40,
//0x00,0x00,0x00,0x02,0x03,0x02,0x02,0x02,0x02,0x22,0x22,0x1E,0x00,0x00,/* 号 */
//0x00,0xF2,0x12,0x12,0x1E,0x00,0xC0,0x5E,0x52,0xF2,0x52,0x5E,0xC0,0x00,
//0x00,0x01,0x21,0x21,0x1F,0x10,0x13,0x12,0x12,0x1F,0x12,0x12,0x1B,0x30,/* 强 */
};

CONST_DATA uint8_t Nozimo[28]=
{0x00,0x00,0xFC,0x04,0x04,0x04,0x04,0x04,0x04,0x04,0x04,0xFC,0x00,0x00,
 0x00,0x00,0x3F,0x20,0x20,0x20,0x20,0x20,0x20,0x20,0x20,0x3F,0x00,0x00};

#endif

#ifdef FEATURE_BMP
CONST_DATA unsigned char Scale1_8x128[]=
{
0xFF,0x31,0x3F,0x20,0x20,0x60,0x20,0x20,0x20,0x20,0xFF,0x20,0x20,0x20,0x20,0x60,
0x20,0x20,0x20,0x3D,0xF5,0x37,0x20,0x20,0x20,0x60,0x20,0x20,0x20,0x35,0xF5,0x3F,
0x20,0x20,0x20,0x60,0x20,0x20,0x27,0x24,0xFF,0x24,0x20,0x20,0x20,0x60,0x20,0x20,
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0x20,0x20,0x20,0x60,0x20,0x20,0x20,0x3D,0xF5,0x37,0x20,0x20,0x20,0x60,0x20,0x20
};
#endif

void SPI_WrDat(unsigned char dat)
{
  unsigned char i=8;
//  OLED_CS_0;
//  OLED_DC_1;
//  __NOP();__NOP();__NOP();__NOP(); // yanshi
//  OLED_SCL_0;;
//  __NOP();__NOP();__NOP();__NOP(); // yanshi
  while(i--)
  {
    if(dat&0x80)            // 注意此处若为51单片机，采用CY位的方法速度略有提升。f = 340KHz -> 390KHz @12MHz
      OLED_SDA_1;
    else
      OLED_SDA_0;
//    __NOP();__NOP();// yanshi
    OLED_SCL_1;
//    __NOP();__NOP();// yanshi
    OLED_SCL_0;   
//    __NOP();__NOP();// yanshi
    dat<<=1;
  }
//  OLED_CS_1;
}
void SPI_WrCmd(unsigned char cmd)
{
  unsigned char i;
//  OLED_CS_0;
  OLED_DC_0;;
//  __NOP();__NOP();__NOP();__NOP(); // yanshi
//  OLED_SCL_0;;
//  __NOP();__NOP();__NOP();__NOP();// yanshi
  for(i=0;i<8;i++)
  {
   if(cmd&0x80)
      OLED_SDA_1;
   else
      OLED_SDA_0;
//   __NOP();__NOP();// yanshi 
   OLED_SCL_1;
//   __NOP();__NOP();// yanshi   
   OLED_SCL_0;
//   __NOP();__NOP();// yanshi  
   cmd<<=1;;  
  }
  OLED_DC_1;;
//  OLED_CS_1;
}
void OLED_Set_Pos(unsigned char x, unsigned char y)
{ 
  #ifdef CHIP_SH1106
  x += 2;
  #endif
  SPI_WrCmd(0xb0+y);
  SPI_WrCmd(x&0x0f);
  SPI_WrCmd(((x&0xf0)>>4)|0x10);
} 
void OLED_PutPixel(uint8_t x,uint8_t y)
{
    SPI_WrCmd(0xb0+7-y/8);   //0xb0+0~7表示页0~页7?
    #ifdef CHIP_SH1106    //0x00+0~16表示将128列分成16组其地址在某组中的第几列
    SPI_WrCmd(0x02 + x%16);
    #else 
    SPI_WrCmd(0x00 + x%16);
    #endif  
    SPI_WrCmd(0x10 + x/16);     //0x10+0~16表示将128列分成16组其地址所在第几组
    SPI_WrDat(0x80>>(y%8));
}
/******************************************************************************
      函数说明：设置起始和结束地址
      入口数据：x1,x2 设置列的起始和结束地址
                y1,y2 设置行的起始和结束地址
      返回值：  无
******************************************************************************/
#ifdef OLED_COLOR
void OLED_Address_Set(u8 x1,u8 y1,u8 x2,u8 y2)
{
#if defined(CHIP_SSD1331)
    SPI_WrCmd(0x15);//列地址设置
    SPI_WrCmd(x1);
    SPI_WrCmd(x2);
    SPI_WrCmd(0x75);//行地址设置
    SPI_WrCmd(y1);
    SPI_WrCmd(y2);
#elif  defined(CHIP_SSD1351)
    SPI_WrCmd(0x15);//列地址设置
    SPI_WrDat(x1);
    SPI_WrDat(x2);
    SPI_WrCmd(0x75);//行地址设置
    SPI_WrDat(y1);
    SPI_WrDat(y2);
    SPI_WrCmd(0x5c);
#elif defined(CHIP_ST7735)
    SPI_WrCmd(0x2a);//列地址设置
    SPI_WrDat((y1+26) >> 8);  
    SPI_WrDat( y1+26);
    SPI_WrDat((y2+26) >> 8);
    SPI_WrDat( y2+26);
    SPI_WrCmd(0x2b);//行地址设置
    SPI_WrDat((x1+1) >> 8);
    SPI_WrDat( x1+1);
    SPI_WrDat((x2+1) >> 8);
    SPI_WrDat( x2+1);
    SPI_WrCmd(0x2c);//储存器写
#endif
}

void LCD_DrawPoint(u8 x, u8 y, u16 color)
{
    OLED_Address_Set(x,y,x,y);
    SPI_WrDat(color>>8);
    SPI_WrDat(color);
}
#endif
void LCD_DrawColor(u16 color)
{
    SPI_WrDat(color>>8);
    SPI_WrDat(color);
}

void OLED_Fill(unsigned int usData)
{
    unsigned char y,x;

#if defined(CHIP_SSD1331) || defined(CHIP_SSD1351) || defined(CHIP_ST7735)
    OLED_Address_Set(0,0,OLED_WIDTH - 1,OLED_HIGH-1);
    for(x=0; x < OLED_HIGH; x++)
    {
        for (y=0; y < OLED_WIDTH; y++)
        {
            SPI_WrDat(usData >> 8);
            SPI_WrDat(usData);
        }
    }
#else
	for(y=0; y< (OLED_LINE_MAX + LINE_HEIGHT); y++)
	{
		SPI_WrCmd(0xb0+y);
        #ifdef CHIP_SH1106
        SPI_WrCmd(0x02);
        #else 
		SPI_WrCmd(0x00);
        #endif
		SPI_WrCmd(0x10);
		for(x=0;x<OLED_WIDTH;x++)
			SPI_WrDat(usData);
	}
#endif
}

void OLED_Init(void)        
{  
#ifdef  STM32F10X_HD
    GPIO_InitTypeDef  GPIO_InitStructure;

    RCC_APB2PeriphClockCmd(RCC_APB2Periph_GPIOB|RCC_APB2Periph_GPIOC, ENABLE );

    RCC_APB2PeriphClockCmd(RCC_APB2Periph_AFIO, ENABLE);
    GPIO_PinRemapConfig(GPIO_Remap_SWJ_JTAGDisable , ENABLE);           /* JTAG-DP 失能 + SW-DP使能 */
    GPIO_InitStructure.GPIO_Pin = GPIO_Pin_6;
    GPIO_InitStructure.GPIO_Mode = GPIO_Mode_Out_PP;
    GPIO_InitStructure.GPIO_Speed = GPIO_Speed_50MHz;
    GPIO_Init(GPIOC, &GPIO_InitStructure);
    GPIO_SetBits(GPIOC, GPIO_Pin_6);
    GPIO_InitStructure.GPIO_Pin = GPIO_Pin_0 | GPIO_Pin_2 | GPIO_Pin_4 | GPIO_Pin_6 | GPIO_Pin_8;
    GPIO_InitStructure.GPIO_Mode = GPIO_Mode_Out_PP; 
    GPIO_InitStructure.GPIO_Speed = GPIO_Speed_50MHz;
    GPIO_Init(GPIOB, &GPIO_InitStructure);
    GPIO_SetBits(GPIOB, GPIO_Pin_0 | GPIO_Pin_2 | GPIO_Pin_4 | GPIO_Pin_6 | GPIO_Pin_8);
#endif
    
    OLED_SCL_0;   // 预置为底 为了加快速度
    OLED_CS_0;    // 总是选中 为了加快速度  
    OLED_DC_1;    // 默认数据 为了加快速度  6.35ms->5.38ms
    OLED_RST_0;   // 上电复位
    msDelay(100);
    OLED_RST_1;
    msDelay(100);
    
#ifdef CHIP_SSD1331
    {
    SPI_WrCmd(0xAE);
    SPI_WrCmd(0xA0);
    SPI_WrCmd(0x72);
    SPI_WrCmd(0xA1);
    SPI_WrCmd(0x00);
    SPI_WrCmd(0xA2);
    SPI_WrCmd(0x00);
    SPI_WrCmd(0xA4);
    SPI_WrCmd(0xA8);
    SPI_WrCmd(0x3F);
    SPI_WrCmd(0xAD);
    SPI_WrCmd(0x8E);
    SPI_WrCmd(0xB0);
    SPI_WrCmd(0x0B);
    SPI_WrCmd(0xB1);
    SPI_WrCmd(0x31);
    SPI_WrCmd(0xB3);
    SPI_WrCmd(0xF0);
    SPI_WrCmd(0x8A);
    SPI_WrCmd(0x64);
    SPI_WrCmd(0x8B);
    SPI_WrCmd(0x78);
    SPI_WrCmd(0x8C);
    SPI_WrCmd(0x64);
    SPI_WrCmd(0xBB);
    SPI_WrCmd(0x3A);
    SPI_WrCmd(0xBE);
    SPI_WrCmd(0x3E);
    SPI_WrCmd(0x87);
    SPI_WrCmd(0x06);
    SPI_WrCmd(0x81);
    SPI_WrCmd(0x91);
    SPI_WrCmd(0x82);
    SPI_WrCmd(0x50);
    SPI_WrCmd(0x83);
    SPI_WrCmd(0x7D);
    SPI_WrCmd(0xAF);
    OLED_Fill(0x00);}
#elif defined(CHIP_SSD1351)
    {
    SPI_WrCmd(0xFD); // set comand lockDriver IC interface is unlocked from entering command
    SPI_WrDat(0x12); // Unlock Driver IC (0x12/0x16/0xB0/0xB1)  0x12 => Driver IC interface is unlocked from entering command.
    SPI_WrCmd(0xFD);
    SPI_WrDat(0xB1); // Unlock All Commands (0x12/0x16/0xB0/0xB1)
    SPI_WrCmd(0xAE); // Display Off (Sleep Mode On)
    SPI_WrCmd(0xB3);
    SPI_WrDat(0xF1); // Set Clock as 90 Frames/Sec
    SPI_WrCmd(0xCA);
    SPI_WrDat(0x7F); // 1/128 Duty (0x0F~0x7F)
    SPI_WrCmd(0xA2);
    SPI_WrDat(0x00); // Shift Mapping RAM Counter (0x00~0x7F)
    SPI_WrCmd(0xA1);
    SPI_WrDat(0x00); // Set Mapping RAM Display Start Line (0x00~0x7F)
    SPI_WrCmd(0xA0);
    SPI_WrDat(0x75); // 0x74 Horizontal Address Increment mode ******************* 0x75 vertical address increment mode
    SPI_WrCmd(0xB5);
    SPI_WrDat(0x00); // Disable GPIO Pins Input
    SPI_WrCmd(0xAB);
    SPI_WrDat(0x01); // Enable Internal VDD Regulator
    SPI_WrCmd(0xB4);
    SPI_WrDat(0xA0); 
    SPI_WrDat(0xB5);
    SPI_WrDat(0x55); // Enable External VSL
    SPI_WrCmd(0xC1);
    SPI_WrDat(0xC8); // Set Contrast of Color A (Red)
    SPI_WrDat(0x80); // Set Contrast of Color B (Green)
    SPI_WrDat(0xC8); // Set Contrast of Color C (Blue)
    SPI_WrCmd(0xC7); 
    SPI_WrDat(0x0F); // Master Contrast Current Control  Default => 0x0F (Maximum)
    /* Set_Gray_Scale_Table() */
    SPI_WrCmd(0xB1); 
    SPI_WrDat(0x32); // Set Phase 1 as 5 Clocks & Phase 2 as 3 Clocks
    SPI_WrCmd(0xBB);
    SPI_WrDat(0x17); // Set Pre-Charge Voltage Level as 0.50*VCC
    SPI_WrCmd(0xB2);
    SPI_WrDat(0xA4); //  Enhance Display Performance
    SPI_WrDat(0x00);
    SPI_WrDat(0x00);
    SPI_WrCmd(0xB6);
    SPI_WrDat(0x01); // Set Second Pre-Charge Period as 1 Clock
    SPI_WrCmd(0xBE);
    SPI_WrDat(0x05); // Set Common Pins Deselect Voltage Level as 0.82*VCC
    SPI_WrCmd(0xA6); // Normal Display
                    //     0xA4 (0x00) => Entire Display Off, All Pixels Turn Off
                    //     0xA5 (0x01) => Entire Display On, All Pixels Turn On at GS Level 63
                    //     0xA6 (0x02) => Normal Display
                    //     0xA7 (0x03) => Inverse Display
    SPI_WrCmd(0xAF);
    OLED_Fill(0x00);}
#elif defined(CHIP_ST7735)
    {
    LCD_BLK_1;//打开背光
    SPI_WrCmd(0x11);     //Sleep out
    msDelay(120);                //Delay 120ms
    SPI_WrCmd(0xB1);     //Normal mode
    SPI_WrDat(0x05);   
    SPI_WrDat(0x3C);   
    SPI_WrDat(0x3C);   
    SPI_WrCmd(0xB2);     //Idle mode
    SPI_WrDat(0x05);   
    SPI_WrDat(0x3C);   
    SPI_WrDat(0x3C);   
    SPI_WrCmd(0xB3);     //Partial mode
    SPI_WrDat(0x05);   
    SPI_WrDat(0x3C);   
    SPI_WrDat(0x3C);   
    SPI_WrDat(0x05);   
    SPI_WrDat(0x3C);   
    SPI_WrDat(0x3C);   
    SPI_WrCmd(0xB4);     //Dot inversion
    SPI_WrDat(0x03);   
    SPI_WrCmd(0xC0);     //AVDD GVDD
    SPI_WrDat(0xAB);   
    SPI_WrDat(0x0B);   
    SPI_WrDat(0x04);   
    SPI_WrCmd(0xC1);     //VGH VGL
    SPI_WrDat(0xC5);   //C0
    SPI_WrCmd(0xC2);     //Normal Mode
    SPI_WrDat(0x0D);   
    SPI_WrDat(0x00);   
    SPI_WrCmd(0xC3);     //Idle
    SPI_WrDat(0x8D);   
    SPI_WrDat(0x6A);   
    SPI_WrCmd(0xC4);     //Partial+Full
    SPI_WrDat(0x8D);   
    SPI_WrDat(0xEE);   
    SPI_WrCmd(0xC5);     //VCOM
    SPI_WrDat(0x0F);   
    SPI_WrCmd(0xE0);     //positive gamma
    SPI_WrDat(0x07);   
    SPI_WrDat(0x0E);   
    SPI_WrDat(0x08);   
    SPI_WrDat(0x07);   
    SPI_WrDat(0x10);   
    SPI_WrDat(0x07);   
    SPI_WrDat(0x02);   
    SPI_WrDat(0x07);   
    SPI_WrDat(0x09);   
    SPI_WrDat(0x0F);   
    SPI_WrDat(0x25);   
    SPI_WrDat(0x36);   
    SPI_WrDat(0x00);   
    SPI_WrDat(0x08);   
    SPI_WrDat(0x04);   
    SPI_WrDat(0x10);   
    SPI_WrCmd(0xE1);     //negative gamma
    SPI_WrDat(0x0A);   
    SPI_WrDat(0x0D);   
    SPI_WrDat(0x08);   
    SPI_WrDat(0x07);   
    SPI_WrDat(0x0F);   
    SPI_WrDat(0x07);   
    SPI_WrDat(0x02);   
    SPI_WrDat(0x07);   
    SPI_WrDat(0x09);   
    SPI_WrDat(0x0F);   
    SPI_WrDat(0x25);   
    SPI_WrDat(0x35);   
    SPI_WrDat(0x00);   
    SPI_WrDat(0x09);   
    SPI_WrDat(0x04);   
    SPI_WrDat(0x10);
         
    SPI_WrCmd(0xFC);    
    SPI_WrDat(0x80);  
        
    SPI_WrCmd(0x3A);     
    SPI_WrDat(0x55);   
    SPI_WrCmd(0x36);
    /* 
     * SPI_WrDat(0x08); Vertical
     * SPI_WrDat(0xC8); Vertical
     * SPI_WrDat(0x78); Landscope 正置
       SPI_WrDat(0xA8); Landscope 倒置*/
    SPI_WrDat(0x88);     //Landscope   0x48 正置 0x88 倒置
    SPI_WrCmd(0x21);     //Display inversion
    SPI_WrCmd(0x29);     //Display on
//    SPI_WrCmd(0x2A);     //Set Column Address
//    SPI_WrDat(0x00);   
//    SPI_WrDat(0x1A);     //26  
//    SPI_WrDat(0x00);   
//    SPI_WrDat(0x69);     //105 
//    SPI_WrCmd(0x2B);     //Set Page Address
//    SPI_WrDat(0x00);   
//    SPI_WrDat(0x01);    //1
//    SPI_WrDat(0x00);   
//    SPI_WrDat(0xA0);    //160
//    SPI_WrCmd(0x2C);
    }
#else 
    {//从上电到下面开始初始化要有足够的时间，即等待RC复位完毕   
    SPI_WrCmd(0xFD);// 待验证新增  SSD1306pass
    SPI_WrCmd(0x12);// 待验证新增  SSD1306pass
    SPI_WrCmd(0xae);//--turn off oled panel
    SPI_WrCmd(0xd5);//--set display clock divide ratio/oscillator frequency
    SPI_WrCmd(0xA0);// 待验证新增
   
    SPI_WrCmd(0xa8);//--set multiplex ratio(1 to 64)
    SPI_WrCmd(0x3f);//--1/64 duty
    SPI_WrCmd(0xd3);//-set display offset    Shift Mapping RAM Counter (0x00~0x3F)
    SPI_WrCmd(0x00);//-not offset    
    SPI_WrCmd(0x40);//--set start line address  Set Mapping RAM Display Start Line (0x00~0x3F)

//    SPI_WrCmd(0xa6);//--set normal display  待验证可删 SSD1306pass 

    SPI_WrCmd(Landscope);//--Set SEG/Column Mapping     0xa0左右反置 0xa1正常
    SPI_WrCmd(Verticall);//Set COM/Row Scan Direction   0xc0上下反置 0xc8正常
    SPI_WrCmd(0xda);//--set com pins hardware configuration
    SPI_WrCmd(0x12);
    SPI_WrCmd(0x81);//--set contrast control register
    SPI_WrCmd(Brightness); // Set SEG Output Current Brightness
   
#ifdef CHIP_SSD1306   
    SPI_WrCmd(0x80);//--set divide ratio, Set Clock as 100 Frames/Sec
    SPI_WrCmd(0xd9);//--set pre-charge period
    SPI_WrCmd(0xf1);//Set Pre-Charge as 15 Clocks & Discharge as 1 Clock
    SPI_WrCmd(0xdb);//--set vcomh
    SPI_WrCmd(0x40);//Set VCOM Deselect Level
    SPI_WrCmd(0x8d);//--set Charge Pump enable/disable
    SPI_WrCmd(0x14);//--set(0x10) disable
#elif defined(CHIP_SSD1309)
    SPI_WrCmd(0xD9);//--set pre-charge period
    SPI_WrCmd(0x82);//Set Pre-Charge as 15 Clocks & Discharge as 1 Clock
    SPI_WrCmd(0xDB);//--set vcomh
    SPI_WrCmd(0x34);//Set VCOM Deselect Level
#elif defined(CHIP_SH1106)
    SPI_WrCmd(0xad);
    SPI_WrCmd(0x8b);
    SPI_WrCmd(0x33);
    SPI_WrCmd(0x8d);//--set Charge Pump enable/disable
    SPI_WrCmd(0x14);//--set(0x10) disable
#else 
    #error "NO OLED CHIP SELECTED"
#endif
    //SPI_WrCmd(0x20);//-Set Page Addressing Mode (0x00/0x01/0x02)
    //SPI_WrCmd(0x02);//
    SPI_WrCmd(0xa4);// Disable Entire Display On (0xa4/0xa5) //验证新增  SSD1306pass
    SPI_WrCmd(0xa6);// Disable Inverse Display On (0xa6/a7)  //验证新增  SSD1306pass
    OLED_Fill(0x00);  //初始清屏
    SPI_WrCmd(0xaf);//--turn on oled panel
    OLED_Set_Pos(0,0);}
#endif   /* NOT SSD1331 */
}

/* m^n */  
uint32_t mypow(uint8_t m,uint8_t n)
{
    uint32_t result=1;	 
    while(n--)result*=m;    
    return result;
}
/**
*********************************************************************************************************
** @nameis OLED_PutChar
** @effect 写一个字符
** @import x 显示的列坐标 y 显示的行坐标 wan 待写字符 ucYn 字体颜色(单色OLED屏幕0为反显，1为正常显示)
** @export none
** @return none
** @create yizhi 2023.03.27
** @modify  
*********************************************************************************************************/
void OLED_PutChar(uint8_t x,uint8_t y,uint8_t wan, u8 ucSize, uint16_t ucYn)
{   
#ifdef OLED_COLOR
    u8 pos,t,ucHeight;
    u32 ulTemp;
#else
    u8 i, j, ucTemp;
#endif
    if(x > (OLED_WIDTH - ucSize))   return; 
    if (ucSize <= 8) {
        wan = wan-' ';
    } else if (ucSize == 16){
        if (wan >= '0' && wan <= '9') {
            wan = wan - '0';
        } else if (wan == 127)  {                                   /* 摄氏度 */
            wan = 10;
        } else if (wan == 128) {
            wan = 11;
        } else if (wan == 'V') {
            wan = 12;
        } else if (wan == 'A') {
            wan = 13;
        } else if (wan == 'm') {
            wan = 14;
        } else if (wan == '.') {
            wan = 15;
        } else if (wan == '-') {
            wan = 16;
        } else if (wan == ':') {
            wan = 17;
        } else {
            return;                                                 /* 不支持显示的字符 */
        }
    }  else {
        return;                                                     /* 不支持的字号     */
    }
#ifdef OLED_COLOR
    OLED_Address_Set(x, y, x + ucSize - 1, y + (ucSize << 1 & 0xF8) - 1);/* set refresh windows                  */
    for(pos = 0; pos < ucSize; pos++)                                   /* ucSize also represent character width*/
    {
        if (ucSize == 6) {
     #ifdef FEATURE_F6x8
            ulTemp = F6x8[wan][pos];                                    /* 调用0608字体  */ 
     #else   
            ulTemp = 0xCC;
     #endif 
            ucHeight = 8;                                               /* ucHeight represent character Height */
        } else if (ucSize == 8) {
    #ifdef  FEATURE_F8x16
            ulTemp = (F8X16[wan][pos + 8] << 8) | F8X16[wan][pos]; /* 调用1608字体 */
    #else 
            ulTemp = 0xCCCC;                                            /* 显示斑马纹 */
    #endif
            ucHeight = 16;                                              /* ucHeight represent character Height */
        } else if (ucSize == 16) {
    #ifdef  FEATURE_F16x32
            ulTemp = (F16X32[wan][pos + 48] << 24) | (F16X32[wan][pos + 32] << 16) |
                     (F16X32[wan][pos + 16] << 8 ) | (F16X32[wan][pos]);/* 调用3216字体           */
    #else 
            ulTemp = 0xCCCCCCCC;                                        /* 显示斑马纹 */
    #endif
            ucHeight = 32;                                              /* ucHeight represent character Height */
        } else {
            return;
        }
        for (t = 0; t < ucHeight; t++)
        {
            if (ulTemp & 0x01) {
                SPI_WrDat(ucYn>>8); SPI_WrDat(ucYn);//LCD_DrawColor(ucYn);
            } else {
                SPI_WrDat(BACK_COLOR>>8); SPI_WrDat(BACK_COLOR);//LCD_DrawColor(BACK_COLOR);
            }
            ulTemp >>= 1;
        }
    }

#else
    for (j = 0; j < (ucSize >> 2); j++) {
        OLED_Set_Pos(x, y + j);
        for(i=0; i < ucSize; i++) {
            if (ucSize == 6) {
    #ifdef  FEATURE_F6x8
                ucTemp = F6x8[wan][i];
    #else        
                ucTemp = 0xCC;
    #endif
            } else if (ucSize == 8) {
    #ifdef  FEATURE_F8x16
                ucTemp = F8X16[wan][i + (ucSize * j)];
    #else 
                ucTemp = 0xCC;
    #endif
            } else if (ucSize == 16) {
    #ifdef      FEATURE_F16x32
                ucTemp = F16X32[wan][i + (ucSize * j)];/* 调用3216字体           */
    #else 
                ucTemp = 0xCC;                                        /* 显示斑马纹 */
    #endif
            } else {
                return;
            }
            ucYn ? SPI_WrDat(ucTemp) : SPI_WrDat(~ucTemp);
        }
    }
#endif
}
//==m============================================================
//函数名：OLED_P8x16Str(uint8_t x,uint8_t y,uint8_t *p)
//功能描述：写入一组标准ASCII字符串
//参数：显示的位置（x,y），y为页范围0～7，要显示的字符串
//返回：无   yn=1  正常显示  yn=0 反黑显示 
//==============================================================  
void OLED_PutStr(uint8_t x,uint8_t y,uint8_t ch[], u8 ucSize, uint16_t ucYn)
{
    uint8_t j=0, wan;
    
    if (ucYn == 1) ucYn = FRONT_COLOR;
    while (ch[j]!='\0')
    {    
        wan = ch[j];
        if(x > (OLED_WIDTH - ucSize))
        {
            x=0;
#ifdef      OLED_COLOR
            y +=  (ucSize << 1) & 0x18;  /*  y += (ucSize == 6 ? (LINE_HEIGHT >> 1) : LINE_HEIGHT); which is faster ? */
#else 
            y += ((ucSize & 0x08) ? 2 : 1);   
#endif
            if (y > OLED_LINE_MAX)       // 此处有一个待处理的BUG，若显示字体为6号，最后一行书写不了。
                return;
        }
        
       /* 
        * 特殊单位符号处理 ℃=0xA1E6
        */
        if (wan == 0xA1) wan = 127;
        if (wan == 0xE6) wan = 128;                                     /* 摄氏度                       */
        OLED_PutChar(x, y, wan, ucSize, ucYn);
        x += ucSize;
        j++; 
    }
}

/**
*********************************************************************************************************
** @nameis OLED_P8x16Num
** @effect 显示N位整数 从最低位开始写
** @import x 显示的列坐标 y 显示的行坐标 m 待显示数值 ucLen 位数 ucYn 字体颜色(单色OLED屏幕0为反显，1为正常显示)
** @export none
** @return none
** @create yizhi 2023.03.19
** @modify  
*********************************************************************************************************/
void OLED_PutNum(uint8_t x,uint8_t y,int m, uint8_t ucLen, u8 ucSize, uint16_t ucYn)
{
    int8_t i, ucNegative = 0;
    if (ucYn == 1) ucYn = FRONT_COLOR;
    /*if (m < 0) {
        m = -m;
        OLED_PutChar(x, y, '-', ucYn);
        x += 8;
    } else {
        OLED_PutChar(x, y, ' ', ucYn);
        x += 8;
    }
    ucWei[4] = m%10;
    ucWei[3] = m%100/10;
    ucWei[2] = m%1000/100;
    ucWei[1] = m/1000%10;
    ucWei[0] = m/10000;
    
    for (i = (5 - ucLen); i < 5; i++) {
        OLED_PutChar(x, y, '0' + ucWei[i], ucYn);
        x += 8;
    } */
    if (m < 0) {
        m = -m;
        ucNegative = 1;
    }
    i = ucLen - 1;
    if (m) {
        while(m) {
            OLED_PutChar(x + i-- * ucSize, y, '0' + m % 10, ucSize, ucYn);
            m /= 10;
            if (i < 0) break;
        }
    }  else {
        OLED_PutChar(x + i-- * ucSize, y, '0', ucSize, ucYn);
    }
    if (ucNegative && i >= 0)
    {
        OLED_PutChar(x + i-- * ucSize, y, '-', ucSize, ucYn); 
    }
    while(i >= 0) {
        OLED_PutChar(x + i-- * ucSize, y, ' ', ucSize, ucYn);          /* 整数高位灭零 */ 
    }
}
/**
********************************************************************************************************
** @nameis OLED_PutNumber
** @effect 显示00000.0000 的小数, 若表示为M.N，此处M表示整数位数，N表示小数位数，比如圆周率以1.2格式显示
**         为3.14，若N为0则不显示小数点。若M=5 N=2则表示的整数部分最大范围-9999~65535，小数部分0.01~0.99
** @import x 显示的列坐标 y 显示的行坐标 m 待显示数值 M 1~5整数位数 N 0~2小数位数 pUnit 单位(ASSIC字符，
**         特别地 0为不显示单位) ucYn 字体颜色(对于单色OLED屏幕0为反显，1为正常显示)
** @export none
** @return none
** @create yizhi 2023.03.19
** @modify 
*********************************************************************************************************/
void OLED_PutNumber(u8 x,u8 y,float m, u8 M, u8 N, char* pUnit, u8 ucSize, uint16_t ucYn)
{
#if    0          //高位灭零  负号位置固定 小数点浮动 单位浮动
    uint8_t subshi,subbai;
    uint8_t length=0,x_temp;
    uint16_t inte,temp;//deci;
    static  uint8_t ucLastOCCupy;
    
    if (ucYn == 1) ucYn = FRONT_COLOR;
    if(m<0)
    {
        OLED_PutChar(x, y, '-', ucYn);
        m=-m;
        x+=8;
    } 
    else
    {
        OLED_PutChar(x,y,' ', ucYn); x+=8; 
    }
   inte=(int16_t)m;  // 取出整数部分 
   temp=inte;

    x_temp=x; 
    while(temp)  //看整数部分有几位 
    {
        temp /= 10;
        length ++;
        x_temp+=8;
    }
    if(length)
    {
        length--;
        while(inte)
        {
            OLED_PutChar(x+8*(length--),y,'0'+inte%10, ucYn);                         /* 先写整数部分的个位 */
            inte/=10;
        }
        x=x_temp;
    }
    else //整数部分为零  这就用不到x_temp 了
    {
      OLED_PutChar(x,y,'0', ucYn); x+=8;
    }

    if (ucFracNum > 0) {
        OLED_PutChar(x,y,'.', ucYn); x+=8; // 写小数点，小数点跟随前面的整数位数，位置浮动。
        subshi=(uint16_t)(m*10)%10;
        OLED_PutChar(x,y,'0'+subshi, ucYn); x+=8; // 显示十分位
    }
    if (ucFracNum == 2) {
        subbai=(uint16_t)(m*100)%10; 
        OLED_PutChar(x,y,'0'+subbai, ucYn); x+=8; // 显示百分位
    }
    switch (ucUnit) {
    
    case 0:                                // 摄氏度 95 + 32  96 + 32
        OLED_PutChar(x,y,'F', ucYn); x+=8;
        OLED_PutChar(x,y,'P', ucYn); x+=8;
        OLED_PutChar(x,y,'S', ucYn); x+=8;
        break;
    
    case 1:
        OLED_PutChar(x,y,'V', ucYn); x+=8;
        break;
    
    case 2:
        OLED_PutChar(x,y,'A', ucYn); x+=8;
        break;
    
    case 3:
        OLED_PutChar(x,y,'M', ucYn); x+=8;
        break;

    case 4:
        OLED_PutChar(x,y,'%', ucYn); x+=8;
        break;

    default :
        break;   
    }

    /*
     * 灭掉前一次数值显示的末尾
     */
    x_temp = x;
    while(x < ucLastOCCupy) {
        OLED_PutChar(x,y,' ', ucYn); x+=8;
    }
    ucLastOCCupy = x_temp;

#else   // 固定小数点(整数部分右对齐)  高位灭零  负号位置跟随整数 单位位置固定
    u16      m_int; 
    int8_t   i=0, negative=0;
    uint8_t  subshi, x_decimal;

    if (ucYn == 1) ucYn = FRONT_COLOR;
    if (m < 0) {
        m = -m;
        negative=1; 
    }
    x_decimal = x + M * ucSize;	
    if (N != 0) {
        OLED_PutChar(x_decimal,y,'.', ucSize, ucYn); // 小数点位置固定   
        x_decimal += ucSize;
        i = 1;
        while(N--) {                                                    /* 显示所有的小数位 */
            subshi =  (uint16_t)(m * mypow(10, i++)) % 10;              /* 如果N>4 需要将此处uint16_t 更改为 uint32_t */
            OLED_PutChar(x_decimal, y, '0' + subshi, ucSize, ucYn);
            x_decimal += ucSize;
        }
        if (pUnit)
            OLED_PutStr(x_decimal, y, (uint8_t *)pUnit, ucSize, ucYn);        /*  写单位  */
    } else {
        if (pUnit)
            OLED_PutStr(x_decimal, y, (uint8_t *)pUnit, ucSize, ucYn);        /*  写单位  */
    }

    m_int = (uint16_t)m;
    i = M - 1;
    if (m_int) {
        while (m_int) {
                if (i == 0 && m_int >= 10) {
                    OLED_PutChar(x + i-- * ucSize, y, 'A'+ (m_int - 10), ucSize, ucYn); /* 位数不够用，最高显示位扩展到26个大写字母  */
                } else {
                    OLED_PutChar(x + i-- * ucSize, y, '0'+ m_int%10, ucSize, ucYn);     /* 先写整数部分的个位 */
                }
            m_int /= 10; 
            if (i < 0) break;
        }
    } else {
        OLED_PutChar(x + i-- * ucSize, y, '0', ucSize, ucYn);
    }
    if (negative && i >= 0)
    {
        OLED_PutChar(x + i-- * ucSize, y, '-', ucSize, ucYn); 
    }
    while(i >= 0) {
        OLED_PutChar(x + i-- * ucSize, y, ' ', ucSize, ucYn);          /* 整数高位灭零 */ 
    }
#endif 
/******ALienTek 数字灭零显示方式*****************************／
	for(t=0;t<len;t++)
	{
		temp=(num/mypow(10,len-t-1))%10; //  从整数的最高位开始输出  
		if(enshow==0&&t<(len-1))         // 当enshow为0时说明还遇到第一个非0最高整数位
		{
			if(temp==0)
			{
				LCD_ShowChar(x+(size/2)*t,y,' ',size,0);//灭零吧 yizhi 
				continue; // 本次循环立即结束 
			}
			else 
			{
			  enshow=1; // 遇到第一个非零的最高速，之后无需进行灭零判断。
			}
		 	 
		}
	 	LCD_ShowChar(x+(size/2)*t,y,temp+'0',size,0); 
	}　*/
	/**********************野火 数字显示灭零方式**************************
		while(temp)  //  这个算法我当时想了好久，野火一下子就解决了, 厉害了，比正点原子更佳，野火从个位开始输出。 yizhi 
	{// 得到num的长度
		temp /= 10;
		length ++;
	}
	
	while( num ) // 野火用 while 用的溜呀 
	{
		/／ 从个位开始显示 
		LCD_DispChar((x+STR_WIDTH*(length--)-STR_WIDTH), y, (num%10)+'0', color);
		num /= 10;
	}	 */
}
/*********prepare to lanqiao competition*************************
#function: 16进制显示数据,中间加上'-'分隔符
#input: 显示位置 x y 显示数据dat 显示个数N
#output: none
#others: refer to IAP15F2K60S2 pdf
#description:
#author::  2016-03-21 by yizhi 
******************************************************************/
void OLED_HexDisp(uint8_t x,uint8_t y,uint8_t *dat,uint8_t N, u8 ucSize, uint16_t ucYn)
{
	uint8_t temp,i;
    if (ucYn == 1) ucYn = FRONT_COLOR;
	for(i=0;i<N;i++)
	{
		temp=dat[i];//数组下标方式访问指针数据
		dat[i]>>=4; 
		if(dat[i]<10)
		OLED_PutChar(x,y,'0'+dat[i], ucSize, ucYn);
		else
		OLED_PutChar(x,y,'A'+dat[i]-10, ucSize, ucYn);
		temp&=0x0f;
		x+=8;
		if(temp<10)
		OLED_PutChar(x,y,'0'+temp, ucSize, ucYn);
		else
		OLED_PutChar(x,y,'A'+temp-10, ucSize, ucYn);
		x+=8;
		if(i<(N-1))
		OLED_PutChar(x,y,'-', ucSize, ucYn);
    x+=8;		
 }
}
/**
***********************************************************************
* @file  OLED_PutTime() 
* @author   yizhi OLED显示时间临时存放位置
* @version 
* @date    
* @brief expect for the motify the define Don't forget the RCC_APB2PeriphClockCmd
*********************************************************************
*/
void OLED_PutTime(u8 x,u8 y,RTC_Time_s * time, u8 ucSize, uint16_t ucYn)
{
    if (ucYn == 1) ucYn = FRONT_COLOR;
// OLED_PutChar(x,y,time->year%100/10+0x30); x+=8;
// OLED_PutChar(x,y,time->year%10+0x30);     x+=8;
// OLED_PutChar(x,y,'-'); x+=8;
// OLED_PutChar(x,y,time->month%100/10+0x30);x+=8;
// OLED_PutChar(x,y,time->month%10+0x30);    x+=8;
// OLED_PutChar(x,y,'-'); x+=8;
// OLED_PutChar(x,y,time->date%100/10+0x30); x+=8;
// OLED_PutChar(x,y,time->date%10+0x30);     x+=8; 
// OLED_PutChar(x,y,' '); x+=8; 
// OLED_PutChar(x,y,time->hour%100/10+0x30); x+=8;
// OLED_PutChar(x,y,time->hour%10+0x30);     x+=8; 
// OLED_PutChar(x,y,':'); x+=8;
    OLED_PutChar(x,y,time->minute%100/10+0x30, ucSize, ucYn); x += ucSize;
    OLED_PutChar(x,y,time->minute%10+0x30, ucSize, ucYn);     x += ucSize; 
    OLED_PutChar(x,y,':', ucSize, ucYn);                      x += ucSize;
    OLED_PutChar(x,y,time->second%100/10+0x30, ucSize, ucYn); x += ucSize;
    OLED_PutChar(x,y,time->second%10+0x30, ucSize, ucYn);      	
}

#ifdef FEATURE_HANZI

/*********************************************************************************
# 函数名称: OLED_PutChinese(uint8_t x,uint8_t y,uint8_t ch[])
# 输入参数: x，从哪一列开始输出 y，从哪一行开始输出,字模存放的书组ch[][],输出汉字个数
# 输出参数: void
# 功    能: 索引形式输出汉字, 字模为14x16(这样使得12864OLED每行能够多显示一个汉字)
# 其    他：找不到字模输出一方块, 需要使用取模软件取模 
# 作    者: 2016/1/21,by yizhi
*********************************************************************************/
void OLED_PutHan(uint8_t x,uint8_t y,uint8_t ch[], uint16_t ucYn)
{
    uint8_t wm=0,ii = 0;
    uint16_t adder=0; 
    #ifdef OLED_COLOR
        uint8_t i;
        uint16_t usTemp;
    #endif

    while(ch[ii] != '\0') //挨个输出每个汉字
    {
        wm = 0;
        adder = 0;
        while(F14x16_Idx[wm] > 127) // >127不是字符 yizhi
        {
              if(F14x16_Idx[wm] == ch[ii])
              {
                      if(F14x16_Idx[wm + 1] == ch[ii + 1])
                      {
                              adder = wm * 14;
                              break;
                      }
              }
              wm += 2;
        }  // 挨个（遍历）找出对应字模  yizhi  

        if(x > (OLED_WIDTH - 8))
        {
            x=0;
#ifdef      OLED_COLOR
            y +=  (8 << 1) & 0x18;  /*  y += (ucSize == 6 ? (LINE_HEIGHT >> 1) : LINE_HEIGHT); which is faster ? */
#else 
            y += ((8 & 0x80) ? 2 : 1);
#endif
            if (y > OLED_LINE_MAX)       // 此处有一个待处理的BUG，若显示字体为6号，最后一行书写不了。
                return;
        }
#ifdef OLED_COLOR
        OLED_Address_Set(x, y, x + 14 - 1, y + (16) - 1);
        for(wm = 0;wm < 14;wm++)                       /* 每个汉字需要扫描14列 */
        {
            usTemp = (F14x16[adder + wm + 14] << 8) | F14x16[adder + wm];  /* 得到要扫描的第N列数据 每列数据包含16个点 */
            for (i = 0; i < 16; i++)
            {
                if (usTemp & 0x01) {
                    SPI_WrDat(ucYn>>8); SPI_WrDat(ucYn);//LCD_DrawColor(ucYn);
                } else {
                    SPI_WrDat(BACK_COLOR>>8); SPI_WrDat(BACK_COLOR);//LCD_DrawColor(BACK_COLOR);
                }
                usTemp >>= 1;
            }
        }
#else
        OLED_Set_Pos(x , y);
        for(wm = 0;wm < 14;wm++)
        {
            ucYn ? SPI_WrDat(F14x16[adder++]) : SPI_WrDat(~F14x16[adder++]);
        }      
        OLED_Set_Pos(x,y + 1); 
        for(wm = 0;wm < 14;wm++)          
        {
            ucYn ? SPI_WrDat(F14x16[adder++]) : SPI_WrDat(~F14x16[adder++]);
        }

#endif
        x += 14;
        ii += 2;
    }
}
/**
********************************************************************************************************
** @nameis OLED_PutNumber
** @effect 输出汉字和字符混合字符串
** @import x 显示的列坐标 y 显示的行坐标 ch[] 包含汉字和字符的字符串 ucYn 字体颜色(对于单色OLED屏幕0为反显，1为正常显示)
** @export none
** @return none
** @create yizhi 2023.03.19
** @modify 
*********************************************************************************************************/
void OLED_Print(uint8_t x,uint8_t y,uint8_t ch[], uint16_t ucYn)
{
    uint8_t ch2[3];
    uint8_t ii=0;
    while(ch[ii] != '\0')
    {
        if(ch[ii] > 127)
        {
            ch2[0] = ch[ii];
            ch2[1] = ch[ii + 1];
            ch2[2] = '\0';			//汉字为两个字节
            OLED_PutHan(x , y, ch2, ucYn);	//显示汉字
            x += 14;
            ii += 2;
        }
        else
        {
            ch2[0] = ch[ii];	
            OLED_PutChar(x, y , ch2[0], 8, ucYn);	//显示字母
            x += 8;
            ii+= 1;
        }
    }
}
#endif


#ifdef FEATURE_F16x32

/*
* p: 显示的位置 ，只有两行  第一行 0 第二行 1
 *num： 显示的数据，末位有一小数点。  
 *uint： 数据的单位 uint16_t= 0 no sybmol 1温度2（V）3（A）4（cm） 
*/
//void OLED_P16x32Num(uint8_t p,int num,uint8_t unit)  
//{
//  uint8_t ge=0,shi=0,bai=0,qian=0, wan = 0;
//  uint8_t i=0;
//  uint8_t x=0,y=0;
//  //uint8_t pos=x;
// 
//  if(p==1)  y=4;
//  if (num < 0) num = 0;
//  
//  ge  =num%10;
//  shi =num%100/10;
//  bai =num%1000/100;
//  qian=num%10000/1000;
//  wan =num/10000;
//  
// 
// 
//  if(wan!=0)
//  {
//    OLED_Set_Pos(x,y);                  //write "wan"
//    for(i=0;i<16;i++)
//      SPI_WrDat(F16X32[wan*64+i]);
//    OLED_Set_Pos(x,y+1);
//    for(i=0;i<16;i++)
//      SPI_WrDat(F16X32[wan*64+i+16]); 
//    OLED_Set_Pos(x,y+2);
//    for(i=0;i<16;i++)
//      SPI_WrDat(F16X32[wan*64+i+32]); 
//    OLED_Set_Pos(x,y+3);
//    for(i=0;i<16;i++)
//      SPI_WrDat(F16X32[wan*64+i+48]); 
//    x+=16;
//  }
//  if(qian!=0 || wan != 0)
//  {
//    OLED_Set_Pos(x,y);                  //write "qian"
//    for(i=0;i<16;i++)
//      SPI_WrDat(F16X32[qian*64+i]);
//    OLED_Set_Pos(x,y+1);
//    for(i=0;i<16;i++)
//      SPI_WrDat(F16X32[qian*64+i+16]); 
//    OLED_Set_Pos(x,y+2);
//    for(i=0;i<16;i++)
//      SPI_WrDat(F16X32[qian*64+i+32]); 
//    OLED_Set_Pos(x,y+3);
//    for(i=0;i<16;i++)
//      SPI_WrDat(F16X32[qian*64+i+48]); 
//    x+=16;
//  }
//  
//  if(bai!=0 || qian!=0 || wan != 0)
//  {
//     OLED_Set_Pos(x,y);                  //write "bai"
//    for(i=0;i<16;i++)
//      SPI_WrDat(F16X32[bai*64+i]);
//    OLED_Set_Pos(x,y+1);
//    for(i=0;i<16;i++)
//      SPI_WrDat(F16X32[bai*64+i+16]); 
//    OLED_Set_Pos(x,y+2);
//    for(i=0;i<16;i++)
//      SPI_WrDat(F16X32[bai*64+i+32]); 
//    OLED_Set_Pos(x,y+3);
//    for(i=0;i<16;i++)
//      SPI_WrDat(F16X32[bai*64+i+48]); 
//    x+=16;
//  }
//  OLED_Set_Pos(x,y);                  //write "shi"
//  for(i=0;i<16;i++)
//    SPI_WrDat(F16X32[shi*64+i]);
//  OLED_Set_Pos(x,y+1);
//  for(i=0;i<16;i++)
//    SPI_WrDat(F16X32[shi*64+i+16]); 
//  OLED_Set_Pos(x,y+2);
//  for(i=0;i<16;i++)
//    SPI_WrDat(F16X32[shi*64+i+32]); 
//  OLED_Set_Pos(x,y+3);
//  for(i=0;i<16;i++)
//    SPI_WrDat(F16X32[shi*64+i+48]); 
//  x+=16;
//  
//  OLED_Set_Pos(x,y);                  //write "dot"
//  for(i=0;i<16;i++)
//    SPI_WrDat(F16X32[18*64+i]);
//  OLED_Set_Pos(x,y+1);
//  for(i=0;i<16;i++)
//    SPI_WrDat(F16X32[18*64+i+16]); 
//  OLED_Set_Pos(x,y+2);
//  for(i=0;i<16;i++)
//    SPI_WrDat(F16X32[18*64+i+32]); 
//  OLED_Set_Pos(x,y+3);
//  for(i=0;i<16;i++)
//    SPI_WrDat(F16X32[18*64+i+48]); 
//  x+=16;
//  OLED_Set_Pos(x,y);                  //write "ge"
//  for(i=0;i<16;i++)
//    SPI_WrDat(F16X32[ge*64+i]);
//  OLED_Set_Pos(x,y+1);
//  for(i=0;i<16;i++)
//    SPI_WrDat(F16X32[ge*64+i+16]); 
//  OLED_Set_Pos(x,y+2);
//  for(i=0;i<16;i++)
//    SPI_WrDat(F16X32[ge*64+i+32]); 
//  OLED_Set_Pos(x,y+3);
//  for(i=0;i<16;i++)
//    SPI_WrDat(F16X32[ge*64+i+48]); 
//  x+=16;
//  switch(unit)
//  {
//    
//  case 0 : break;
//  case 1 :
//    OLED_Set_Pos(x,y);                  //write 'C
//    for(i=0;i<32;i++)
//      SPI_WrDat(F16X32[10*64+i]);
//    OLED_Set_Pos(x,y+1);
//    for(i=0;i<32;i++)
//      SPI_WrDat(F16X32[10*64+i+32]); 
//    OLED_Set_Pos(x,y+2);
//    for(i=0;i<32;i++)
//      SPI_WrDat(F16X32[10*64+i+64]); 
//    OLED_Set_Pos(x,y+3);
//    for(i=0;i<32;i++)
//      SPI_WrDat(F16X32[10*64+i+96]); 
//    x+=32;//x+=16; 
//    break;
//  case 2 :
//    OLED_Set_Pos(x,y);                  //write V
//    for(i=0;i<16;i++)
//      SPI_WrDat(F16X32[12*64+i]);
//    OLED_Set_Pos(x,y+1);
//    for(i=0;i<16;i++)
//      SPI_WrDat(F16X32[12*64+i+16]); 
//    OLED_Set_Pos(x,y+2);
//    for(i=0;i<16;i++)
//      SPI_WrDat(F16X32[12*64+i+32]); 
//    OLED_Set_Pos(x,y+3);
//    for(i=0;i<16;i++)
//      SPI_WrDat(F16X32[12*64+i+48]); 
//    x+=16;
//    break;
//  case 3 :
//    OLED_Set_Pos(x,y);                  //write A
//    for(i=0;i<16;i++)
//      SPI_WrDat(F16X32[14*64+i]);
//    OLED_Set_Pos(x,y+1);
//    for(i=0;i<16;i++)
//      SPI_WrDat(F16X32[14*64+i+16]); 
//    OLED_Set_Pos(x,y+2);
//    for(i=0;i<16;i++)
//      SPI_WrDat(F16X32[14*64+i+32]); 
//    OLED_Set_Pos(x,y+3);
//    for(i=0;i<16;i++)
//      SPI_WrDat(F16X32[14*64+i+48]); 
//    x+=16;
//    break;
//  case 4 :
//    OLED_Set_Pos(x,y);                  //write cm
//    for(i=0;i<16;i++)
//      SPI_WrDat(F16X32[16*64+i]);
//    OLED_Set_Pos(x,y+1);
//    for(i=0;i<16;i++)
//      SPI_WrDat(F16X32[16*64+i+16]); 
//    OLED_Set_Pos(x,y+2);
//    for(i=0;i<16;i++)
//      SPI_WrDat(F16X32[16*64+i+32]); 
//    OLED_Set_Pos(x,y+3);
//    for(i=0;i<16;i++)
//      SPI_WrDat(F16X32[16*64+i+48]);
//    x+=16;
//    
//    OLED_Set_Pos(x,y);                 
//    for(i=0;i<16;i++)
//      SPI_WrDat(F16X32[16*64+i+64]);
//    OLED_Set_Pos(x,y+1);
//    for(i=0;i<16;i++)
//      SPI_WrDat(F16X32[16*64+i+80]); 
//    OLED_Set_Pos(x,y+2);
//    for(i=0;i<16;i++)
//      SPI_WrDat(F16X32[16*64+i+96]); 
//    OLED_Set_Pos(x,y+3);
//    for(i=0;i<16;i++)
//      SPI_WrDat(F16X32[16*64+i+112]); 
//    x+=16;
//    
//    break;

//  }
//  while(x<112)  // 空余位清零 
//  {
//    OLED_Set_Pos(x,y);                 
//    for(i=0;i<16;i++)
//      SPI_WrDat(0x00);
//    OLED_Set_Pos(x,y+1);
//    for(i=0;i<16;i++)
//      SPI_WrDat(0x00); 
//    OLED_Set_Pos(x,y+2);
//    for(i=0;i<16;i++)
//      SPI_WrDat(0x00); 
//    OLED_Set_Pos(x,y+3);
//    for(i=0;i<16;i++)
//      SPI_WrDat(0x00); 
//    x+=16;
//  }
//}

/*
 * p : 0 写在第一行，1 写在第二行   OLED 12864屏幕就只有两行 
 */
//void OLED_P16x32Time(uint8_t p, RTC_Time_s *ptTime)
//{
//    uint16_t ge=0;
//    uint8_t i=0;
//    uint8_t x=0,y=0;
//    //uint8_t pos=x;
//    
//    if(p==1)  y=4;
//    ge = (ptTime->hour / 10)*64;
//    OLED_Set_Pos(x,y);                 
//    for(i=0;i<16;i++)
//    SPI_WrDat(F16X32[ge+i]);
//    OLED_Set_Pos(x,y+1);
//    for(i=0;i<16;i++)
//    SPI_WrDat(F16X32[ge+i+16]); 
//    OLED_Set_Pos(x,y+2);
//    for(i=0;i<16;i++)
//    SPI_WrDat(F16X32[ge+i+32]); 
//    OLED_Set_Pos(x,y+3);
//    for(i=0;i<16;i++)
//    SPI_WrDat(F16X32[ge+i+48]); 
//    x+=16;

//    ge = (ptTime->hour % 10)*64;
//    OLED_Set_Pos(x,y);                 
//    for(i=0;i<16;i++)
//    SPI_WrDat(F16X32[ge+i]);
//    OLED_Set_Pos(x,y+1);
//    for(i=0;i<16;i++)
//    SPI_WrDat(F16X32[ge+i+16]); 
//    OLED_Set_Pos(x,y+2);
//    for(i=0;i<16;i++)
//    SPI_WrDat(F16X32[ge+i+32]); 
//    OLED_Set_Pos(x,y+3);
//    for(i=0;i<16;i++)
//    SPI_WrDat(F16X32[ge+i+48]); 
//    x+=16;
//    
//    OLED_Set_Pos(x,y);                  //write "dot"
//    for(i=0;i<16;i++)
//    SPI_WrDat(F16X32[20*64+i]);
//    OLED_Set_Pos(x,y+1);
//    for(i=0;i<16;i++)
//    SPI_WrDat(F16X32[20*64+i+16]); 
//    OLED_Set_Pos(x,y+2);
//    for(i=0;i<16;i++)
//    SPI_WrDat(F16X32[20*64+i+32]); 
//    OLED_Set_Pos(x,y+3);
//    for(i=0;i<16;i++)
//    SPI_WrDat(F16X32[20*64+i+48]); 
//    x+=16;
//    
//    ge = (ptTime->minute / 10)*64;
//    OLED_Set_Pos(x,y);                 
//    for(i=0;i<16;i++)
//    SPI_WrDat(F16X32[ge+i]);
//    OLED_Set_Pos(x,y+1);
//    for(i=0;i<16;i++)
//    SPI_WrDat(F16X32[ge+i+16]); 
//    OLED_Set_Pos(x,y+2);
//    for(i=0;i<16;i++)
//    SPI_WrDat(F16X32[ge+i+32]); 
//    OLED_Set_Pos(x,y+3);
//    for(i=0;i<16;i++)
//    SPI_WrDat(F16X32[ge+i+48]); 
//    x+=16;

//    ge = (ptTime->minute % 10)*64;
//    OLED_Set_Pos(x,y);                 
//    for(i=0;i<16;i++)
//    SPI_WrDat(F16X32[ge+i]);
//    OLED_Set_Pos(x,y+1);
//    for(i=0;i<16;i++)
//    SPI_WrDat(F16X32[ge+i+16]); 
//    OLED_Set_Pos(x,y+2);
//    for(i=0;i<16;i++)
//    SPI_WrDat(F16X32[ge+i+32]); 
//    OLED_Set_Pos(x,y+3);
//    for(i=0;i<16;i++)
//    SPI_WrDat(F16X32[ge+i+48]); 
//    x+=16;
//    
//    
//    OLED_Set_Pos(x,y);                  //write "dot"
//    for(i=0;i<16;i++)
//    SPI_WrDat(F16X32[20*64+i]);
//    OLED_Set_Pos(x,y+1);
//    for(i=0;i<16;i++)
//    SPI_WrDat(F16X32[20*64+i+16]); 
//    OLED_Set_Pos(x,y+2);
//    for(i=0;i<16;i++)
//    SPI_WrDat(F16X32[20*64+i+32]); 
//    OLED_Set_Pos(x,y+3);
//    for(i=0;i<16;i++)
//    SPI_WrDat(F16X32[20*64+i+48]); 
//    x+=16;
//    
//    ge = (ptTime->second / 10)*64;
//    OLED_Set_Pos(x,y);                 
//    for(i=0;i<16;i++)
//    SPI_WrDat(F16X32[ge+i]);
//    OLED_Set_Pos(x,y+1);
//    for(i=0;i<16;i++)
//    SPI_WrDat(F16X32[ge+i+16]); 
//    OLED_Set_Pos(x,y+2);
//    for(i=0;i<16;i++)
//    SPI_WrDat(F16X32[ge+i+32]); 
//    OLED_Set_Pos(x,y+3);
//    for(i=0;i<16;i++)
//    SPI_WrDat(F16X32[ge+i+48]); 
//    x+=16;

//    ge = (ptTime->second % 10)*64;
//    OLED_Set_Pos(x,y);                 
//    for(i=0;i<16;i++)
//    SPI_WrDat(F16X32[ge+i]);
//    OLED_Set_Pos(x,y+1);
//    for(i=0;i<16;i++)
//    SPI_WrDat(F16X32[ge+i+16]); 
//    OLED_Set_Pos(x,y+2);
//    for(i=0;i<16;i++)
//    SPI_WrDat(F16X32[ge+i+32]); 
//    OLED_Set_Pos(x,y+3);
//    for(i=0;i<16;i++)
//    SPI_WrDat(F16X32[ge+i+48]); 
//    x+=16;
//     
//    while(x<112)  // 空余位清零 
//    {
//        OLED_Set_Pos(x,y);                 
//        for(i=0;i<16;i++)
//        SPI_WrDat(0x00);
//        OLED_Set_Pos(x,y+1);
//        for(i=0;i<16;i++)
//        SPI_WrDat(0x00); 
//        OLED_Set_Pos(x,y+2);
//        for(i=0;i<16;i++)
//        SPI_WrDat(0x00); 
//        OLED_Set_Pos(x,y+3);
//        for(i=0;i<16;i++)
//        SPI_WrDat(0x00); 
//        x+=16;
//    }
//}
#endif

    /*
     * stiumulate the clock
     */
void timeClockStep(RTC_Time_s *ptTime)
{
     if (++ptTime->second == 60) {
       if (++ptTime->minute == 60) { 
           if (++ptTime->hour   == 24) {
               ptTime->date++;   
               ptTime->hour   = 0;
           }
           ptTime->minute = 0;
       }               
       ptTime->second = 0;
    }
}



#ifdef FEATURE_BMP
//==============================================================
//函数名： void Draw_BMP(uint8_t x,uint8_t y)
//功能描述：显示BMP图片128×64
//参数：起始点坐标(x,y),x的范围0～127，y为页的范围0～7
//返回：无
//==============================================================
void OLED_DrawBMP(uint8_t x0,uint8_t y0,uint8_t x1,uint8_t y1)
{ 	
    unsigned int  ii=0;
    uint8_t x,y;
    
   // if(y1%8==0) y=y1/8;      
   // else y=y1/8+1;
    for(y=y0;y<=y1;y++)
    {
        OLED_Set_Pos(x0,y);				
        for(x=x0;x<x1;x++)
        {      
            SPI_WrDat(Scale1_8x128[ii++]);	    	
        }
    }
//	for(i=0;i<128;i++)
//	{
//     		
//  }
}
#endif


